## code/linux/net/newip/Kconfig
```kconfig
# SPDX-License-Identifier: GPL-2.0-only
#
# Copyright (c) 2022 Huawei Device Co., Ltd.
#
# NewIP configuration
#

# NewIP as module will cause a CRASH if you try to unload it
menuconfig NEWIP
	tristate "The NewIP protocol"
	default y
	help
	Support for NewIP.

	To compile this protocol support as a module, choose M here: the
	module will be called NewIP.
```

## code/linux/net/newip/hooks/Kconfig
```kconfig
# SPDX-License-Identifier: GPL-2.0-only
#
# Copyright (c) 2022 Huawei Device Co., Ltd.
#
# NewIP Hooks configuration
#

menu "NewIP Hooks"

config NEWIP_HOOKS
	tristate "NewIP Hooks"
	depends on VENDOR_HOOKS && NEWIP
	default n
	help
	  Enable NewIP hooks implemented as tracepoints

	  Allow NewIP modules to attach to tracepoint "hooks" defined via
	  DECLARE_TRACE or DECLARE_HOOK

endmenu
```

## src/linux/net/newip/Kconfig
```kconfig
# SPDX-License-Identifier: GPL-2.0
# Copyright (c) 2022 Huawei Device Co., Ltd.
#

# net/newip/hooks/Kconfig
source "net/newip/hooks/Kconfig"

# net/newip/Kconfig
config NEWIP
	def_bool $(success,$(srctree)/scripts/ohos-check-dir.sh $(srctree)/net/newip)
	depends on INET && NET
	help
	  Support for NewIP.

config NEWIP_FAST_KEEPALIVE
	bool "NewIP fast keepalive"
	default n
	depends on NEWIP
	help
	  Support for NewIP fast keepalive.
```

## src/linux/net/newip/hooks/Kconfig
```kconfig
# SPDX-License-Identifier: GPL-2.0
# Copyright (c) 2022 Huawei Device Co., Ltd.
#

config NEWIP_HOOKS
	def_bool NEWIP
	depends on VENDOR_HOOKS && NEWIP
	help
	  Enable NewIP hooks implemented as tracepoints
	  Allow NewIP modules to attach to tracepoint "hooks" defined via
	  DECLARE_TRACE or DECLARE_HOOK
```
